## firmware/main/Kconfig.projbuild
```kconfig
menu "Configuration"

    config BSP_SD_MOUNT_POINT
        string "BSP_SD_MOUNT_POINT"
        default "/rootfs"
        help
            Sets the mount point of the SD card.

endmenu
```

## firmware/sdkconfig.defaults
```kconfig
CONFIG_ESP32_DEFAULT_CPU_FREQ_160=y
CONFIG_FLASHMODE_QIO=y
CONFIG_ESPTOOLPY_FLASHFREQ_80M=y
CONFIG_ESPTOOLPY_FLASHSIZE_4MB=y
CONFIG_HTTPD_MAX_REQ_HDR_LEN=1024
#
# Partition Table
#
CONFIG_PARTITION_TABLE_CUSTOM=y
CONFIG_PARTITION_TABLE_CUSTOM_FILENAME="partitions.csv"
CONFIG_FATFS_LFN_HEAP=y


CONFIG_LWIP_DHCP_MAX_NTP_SERVERS=5
CONFIG_LWIP_SNTP_UPDATE_DELAY=1800000


CONFIG_LV_BUILD_EXAMPLES=n
CONFIG_LV_USE_USER_DATA=y
CONFIG_LV_COLOR_DEPTH_8=y
CONFIG_LV_USE_TINY_TTF=y
# CONFIG_LV_TINY_TTF_FILE_SUPPORT=y
# CONFIG_LV_USE_FS_STDIO=y
# CONFIG_LV_FS_STDIO_LETTER=47
# CONFIG_LV_FS_STDIO_PATH="/"
# CONFIG_LV_FS_STDIO_CACHE_SIZE=16384

# CONFIG_LV_USE_LOG=y
# CONFIG_LV_LOG_PRINTF=y

CONFIG_LV_USE_ARC=n
CONFIG_LV_USE_BAR=n
CONFIG_LV_USE_BTN=n
CONFIG_LV_USE_BTNMATRIX=n
CONFIG_LV_USE_CANVAS=n
CONFIG_LV_USE_CHECKBOX=n
CONFIG_LV_USE_DROPDOWN=n
CONFIG_LV_USE_IMG=y
CONFIG_LV_USE_LABEL=y
CONFIG_LV_LABEL_LONG_TXT_HINT=y
CONFIG_LV_USE_LINE=y
CONFIG_LV_USE_ROLLER=y
CONFIG_LV_USE_SLIDER=n
CONFIG_LV_USE_SWITCH=n
CONFIG_LV_USE_TEXTAREA=n
CONFIG_LV_USE_TABLE=n
CONFIG_LV_USE_CALENDAR=n
CONFIG_LV_USE_CALENDAR_HEADER_ARROW=n
CONFIG_LV_USE_CALENDAR_HEADER_DROPDOWN=n
CONFIG_LV_USE_CHART=n
CONFIG_LV_USE_COLORWHEEL=n
CONFIG_LV_USE_IMGBTN=n
CONFIG_LV_USE_KEYBOARD=n
CONFIG_LV_USE_LED=n
CONFIG_LV_USE_LIST=n
CONFIG_LV_USE_MENU=n
CONFIG_LV_USE_METER=n
CONFIG_LV_USE_MSGBOX=n
CONFIG_LV_USE_SPAN=n
CONFIG_LV_USE_SPINBOX=n
CONFIG_LV_USE_SPINNER=n
CONFIG_LV_USE_TABVIEW=n
CONFIG_LV_USE_TILEVIEW=n
CONFIG_LV_USE_WIN=n
```
